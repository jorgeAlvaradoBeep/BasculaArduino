#include "HX711.h"
#include <Wire.h>
#include <Adafruit_GFX.h>
#include <Adafruit_SSD1306.h>
#define CALIBRACION -443.84

#define DOUT_PIN 6  // Pin de datos del HX711
#define SCK_PIN 5   // Pin de reloj del HX711

#define SCREEN_WIDTH 128
#define SCREEN_HEIGHT 64
#define OLED_RESET -1
#define SCREEN_ADDRESS 0x3C

Adafruit_SSD1306 display(SCREEN_WIDTH, SCREEN_HEIGHT, &Wire, OLED_RESET);
HX711 scale(DOUT_PIN, SCK_PIN);

byte tara = 12;

#define SCREEN_WIDTH 128  // Ancho del display OLED
#define SCREEN_HEIGHT 64  // Alto del display OLED

long previousWeight = 0;        // Peso previo
const int weightThreshold = 1;  // Umbral de cambio de peso en gramos

const unsigned char PROGMEM logo[] = {
  0xff, 0xff, 0xff, 0xff, 0xff, 0xe0, 0x00, 0x00, 0x00, 0x00, 0x07, 0xff, 0xff, 0xff, 0xff, 0xff,
  0xff, 0xff, 0xff, 0xff, 0xff, 0xe6, 0x00, 0x00, 0x00, 0x00, 0x47, 0xff, 0xff, 0xff, 0xff, 0xff,
  0xff, 0xff, 0xff, 0xff, 0xff, 0xe7, 0xff, 0xff, 0xff, 0xff, 0xe7, 0xff, 0xff, 0xff, 0xff, 0xff,
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  0xff, 0xff, 0xff, 0xff, 0xff, 0xf8, 0x3e, 0xe7, 0xe1, 0xf9, 0xff, 0xff, 0xff, 0xff, 0xff, 0xff
};

void setup() {
  Serial.begin(9600);
  pinMode(tara, INPUT);

  //Iniciamos la pantalla OLED
  if (!display.begin(SSD1306_SWITCHCAPVCC, SCREEN_ADDRESS)) {
    Serial.println("Fallo al iniciar el OLED");
    for (;;)
      ;
  }
  display.display();  // Inicializar la pantalla
  display.clearDisplay();
  display.drawBitmap(0, 0, logo, 128, 64, 1);  // Dibuja el logo
  display.display();
  delay(2000);             // Muestra el logo durante 2 segundos antes de continuar
  display.clearDisplay();  // Limpia la pantalla
  delay(3000);             // Esperar 2 segundos para que se pueda ver el mensaje de inicio
  display.clearDisplay();
  // Calibrar la báscula (debe hacerse cuando no haya nada en la báscula)
  display.setTextSize(3);
  display.setTextColor(SSD1306_WHITE);
  display.setCursor(0, 0);
  display.print("Peso: ");
  display.setCursor(0, 25);
  display.print(0);
  display.print(" g");
  display.display();
  scale.set_scale(CALIBRACION);
  scale.tare();  // Restablecer el valor actual como tara
}

void loop() {


  long currentWeight = scale.get_units(10);  // Obtener el peso en gramos

  // Imprimir el peso solo si la diferencia es mayor que el umbral
  if (abs(currentWeight - previousWeight) >= weightThreshold) {
    display.clearDisplay();
    display.setTextSize(3);
    display.setTextColor(SSD1306_WHITE);
    display.setCursor(0, 0);
    display.print("Peso: ");
    display.setCursor(0, 25);
    display.print(currentWeight);
    display.print(" g");
    display.display();
    previousWeight = currentWeight;
  }

  delay(100);  // Esperar un poco antes de volver a medir
}


void anti_debounce(byte boton) {
  delay(100);
  while (!digitalRead(boton))
    ;  //Anti-Rebote
  delay(100);
}

void animateLogo() {
  for (int x = 0; x < SCREEN_WIDTH; x++) {
    for (int y = 0; y < SCREEN_HEIGHT; y++) {
      // Obtiene el byte que contiene el bit deseado
      byte byteValue = pgm_read_byte(&logo[(x / 8) + y * (SCREEN_WIDTH / 8)]);
      
      // Obtiene el valor del bit dentro del byte usando una máscara de bits
      bool pixelState = bitRead(byteValue, 7 - (x % 8));
      
      // Dibuja el píxel si está activo
      if (pixelState) {
        display.drawPixel(x, y, SSD1306_WHITE);
      }
    }
    display.display(); // Actualiza la pantalla después de dibujar una columna
    delay(10); // Añade un pequeño retraso para controlar la velocidad de la animación
  }
}
